//  ________            ______ ________      _____
//  ___  __ \______________  /____  __ )_______  /_
//  __  / / /  _ \_  ___/_  //_/_  __  |  __ \  __/
//  _  /_/ //  __/(__  )_  ,<  _  /_/ // /_/ / /_
//  /_____/ \___//____/ /_/|_| /_____/ \____/\__/    by Hiruka Chansilu

//  OLED Graphics

//  display.fillRect(StartX, StartY, Width in Pixels, Height in Pixels, WHITE);
//  display.fillCircle(CenterX, CenterY, Radius in Pixels, WHITE);
//  display.drawLine(StartX, StartY, EndX, EndY, WHITE);
//  display.drawBitmap(StartX, StartY, Image_Array, Height in pixels, Width in pixels, WHITE);

//  NodeMCU I2C Pins

//  SDA --> D2
//  SCL --> D1

//  Libraries

#include <SPI.h>
#include <Wire.h>
#include <ESP8266WiFi.h>
#include <ESP8266HTTPClient.h>
#include <WiFiClient.h>
#include <ESP8266WebServer.h>
#include <Arduino_JSON.h>
#include <SoftwareSerial.h>
#include <RTClib.h>
#include <CuteBuzzerSounds.h>
#include <Adafruit_GFX.h>
#include <Adafruit_SSD1306.h>
#include <Fonts/FreeSans12pt7b.h>
#include <Fonts/FreeSans18pt7b.h>

#include <WiFiClientSecure.h>

#include <SpotifyArduino.h>
#include <SpotifyArduinoCert.h>

#include <ArduinoJson.h>

//  Declareations

#define SCREEN_WIDTH 128 // OLED display width, in pixels
#define SCREEN_HEIGHT 64 // OLED display height, in pixels

#define OLED_RESET -1       // Reset pin # (or -1 if sharing Arduino reset pin)
#define SCREEN_ADDRESS 0x3C ///< See datasheet for Address; 0x3D for 128x64, 0x3C for 128x32

#define BUZZER_PIN D5
#define GREEN_LED D6
#define RED_LED D7
#define TOUCH_SENSOR D8

//  Declareations - API / Wifi

const char *ssid = "SSID";
const char *password = "PASSWORD";

String openWeatherMapApiKey = "API_KEY";

String city = "YOUR_CITY";
String countryCode = "LK";

char clientId[] = "SPOTIFY_CLIENT_ID";            // Your client ID of your spotify APP
char clientSecret[] = "SPOTIFY_CLIENT_SECRET_ID"; // Your client Secret of your spotify APP (Do Not share this!)

#define SPOTIFY_MARKET "LK"

#define SPOTIFY_REFRESH_TOKEN "SPOTIFY_REFRESH_TOKEN"

String pre_track = "";

WiFiClientSecure client;
ESP8266WebServer server(80);
SpotifyArduino spotify(client, clientId, clientSecret, SPOTIFY_REFRESH_TOKEN);

String jsonBuffer;

//  Objects

Adafruit_SSD1306 display(SCREEN_WIDTH, SCREEN_HEIGHT, &Wire, OLED_RESET);
RTC_DS3231 rtc;
SoftwareSerial s(D3, D4);

//  Variables

//  Variables - Weather
String temp;
String mood;

//  Variables - getDementions
int16_t x5, y5;
uint16_t w, h;

//  Variables - Http

String httpGETRequest(const char *serverName)
{
  WiFiClient client;
  HTTPClient http;

  // Your IP address with path or Domain name with URL path
  http.begin(client, serverName);

  // Send HTTP POST request
  int httpResponseCode = http.GET();

  String payload = "{}";

  if (httpResponseCode > 0)
  {
    Serial.print("HTTP Response code: ");
    Serial.println(httpResponseCode);
    payload = http.getString();
  }
  else
  {
    Serial.print("Error code: ");
    Serial.println(httpResponseCode);
  }
  // Free resources
  http.end();

  return payload;
}

//  Variables - Timer

bool is_night;
bool is_night_func_goon = true;

int alarm1[2] = {4, 15};          //  Alarm {hour, minute}
bool alarm1_on = true;            //  Alarm Easy Toggle
String alarm1_des = "Wake Up..."; //  Alarm Description - Max 21 Characters
int alarm1_duration = 5;          //  Alarm Duration in Minutes

int alarm2[2] = {4, 30};          //  Alarm {hour, minute}
bool alarm2_on = true;            //  Alarm Easy Toggle
String alarm2_des = "Wake Up..."; //  Alarm Description - Max 21 Characters
int alarm2_duration = 10;         //  Alarm Duration in Minutes

int alarm3[2] = {4, 45};          //  Alarm {hour, minute}
bool alarm3_on = true;            //  Alarm Easy Toggle
String alarm3_des = "Wake Up..."; //  Alarm Description - Max 21 Characters
int alarm3_duration = 10;         //  Alarm Duration in Minutes

int alarm4[2] = {5, 0};           //  Alarm {hour, minute}
bool alarm4_on = true;            //  Alarm Easy Toggle
String alarm4_des = "Wake Up..."; //  Alarm Description - Max 21 Characters
int alarm4_duration = 10;         //  Alarm Duration in Minutes

int alarm5[2] = {5, 15};          //  Alarm {hour, minute}
bool alarm5_on = true;            //  Alarm Easy Toggle
String alarm5_des = "Wake Up..."; //  Alarm Description - Max 21 Characters
int alarm5_duration = 10;         //  Alarm Duration in Minutes

long api_timer_delay = 180000;
long api_last_time = 0;

long blink_timer_delay = 5000; //  5000 - 8000
long blink_last_time = 0;

long side_timer_delay = 30000; //  30000 - 60000
long side_last_time = 0;

long sleep_timer_delay = 300000; //  30000 - 60000
long sleep_last_time = 0;

long rand_on_timer_delay = 600000; //  600000 - 1200000
long rand_on_last_time = 0;

long rand_off_timer_delay = 180000; //  180000 - 600000
long rand_off_last_time = 0;

long spotify_timer_delay = 1000;
long spotify_last_time = 0;

int tried_times = 0;

char daysOfTheWeek[7][12] = {"Sunday", "Monday", "Tuesday", "Wednesday", "Thursday", "Friday", "Saturday"};
String hour_str;
String mins_str;
String time_str;

String date_str;
String dow_str;
String date_and_dow_str;

// Variables - Spotify

String track;
String artists;
int track_x = 0;
int track_x_max;
int artist_x = 0;
int artist_x_max;

long progress_of_track;
long duration_of_track;

int status;
bool playing;

//  Variables - Web Server

bool lights = true;
int mode_of_lights = 0;

//  Bitmaps

static const uint8_t PROGMEM temp_ico[200] = { //  Temp Icon
    0x00, 0x00, 0x3c, 0x00, 0x00,
    0x00, 0x00, 0x7e, 0x00, 0x00,
    0x00, 0x01, 0x81, 0x80, 0x00,
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    0x00, 0x00, 0x3c, 0x00, 0x00};

static const uint8_t PROGMEM wifi_ico[60] = {
    0x00, 0x00, 0x00,
    0x00, 0x00, 0x00,
    0x00, 0x00, 0x00,
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    0x00, 0x00, 0x00};

static const uint8_t PROGMEM sun_ico[350] = {
    0x00, 0x00, 0x00, 0x00, 0x00, 0x00, 0x00,
    0x00, 0x00, 0x00, 0x00, 0x00, 0x00, 0x00,
    0x00, 0x00, 0x00, 0x00, 0x00, 0x00, 0x00,
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    0x00, 0x00, 0x00, 0x00, 0x00, 0x00, 0x00};

static const uint8_t PROGMEM water1[78] = {
    0x00, 0x00, 0x00, 0x01, 0xfe, 0x00,
    0x00, 0x00, 0x00, 0x1f, 0xff, 0xc0,
    0x00, 0x00, 0x00, 0x7f, 0xff, 0xf0,
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    0x7f, 0xff, 0xff, 0xff, 0xff, 0xf8};

static const uint8_t PROGMEM water2[78] = {
    0x03, 0xfc, 0x00, 0x00, 0x00, 0x00,
    0x1f, 0xff, 0xc0, 0x00, 0x00, 0x00,
    0x7f, 0xff, 0xf0, 0x00, 0x00, 0x00,
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    0xff, 0xff, 0xff, 0xff, 0xff, 0xf0};

static const uint8_t PROGMEM rain_ico[350] = {
    0x00, 0x00, 0x00, 0x00, 0x00, 0x00, 0x00,
    0x00, 0x00, 0x00, 0x00, 0x00, 0x00, 0x00,
    0x00, 0x00, 0x00, 0x00, 0x00, 0x00, 0x00,
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    0x00, 0x00, 0x00, 0x00, 0x00, 0x00, 0x00};

static const uint8_t PROGMEM rain1[258] = {
    0x82, 0x88, 0xa4, 0x80, 0x29, 0x00,
    0x82, 0x88, 0xa4, 0xa0, 0x69, 0x00,
    0x90, 0x4a, 0xa4, 0xa6, 0x49, 0x00,
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    0x40, 0x89, 0x11, 0x55, 0x12, 0x40};

static const uint8_t PROGMEM rain2[258] = {
    0x09, 0x40, 0x12, 0x51, 0x14, 0x10,
    0x09, 0x60, 0x52, 0x51, 0x14, 0x10,
    0x09, 0x26, 0x52, 0x55, 0x20, 0x90,
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    0x24, 0x8a, 0xa8, 0x89, 0x10, 0x20};

static const uint8_t PROGMEM cloud_ico[350] = {
    0x00, 0x00, 0x00, 0x00, 0x00, 0x00, 0x00,
    0x00, 0x00, 0x00, 0x00, 0x00, 0x00, 0x00,
    0x00, 0x00, 0x00, 0x00, 0x00, 0x00, 0x00,
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    0x00, 0x00, 0x00, 0x00, 0x00, 0x00, 0x00};

static const uint8_t PROGMEM cloud[279] = {
    0x00, 0x00, 0x00, 0x00, 0x00, 0x00, 0x00, 0x00, 0x00,
    0x00, 0x00, 0x00, 0x00, 0x00, 0x00, 0x00, 0x00, 0x00,
    0x00, 0x00, 0x03, 0xc0, 0x70, 0xf0, 0x00, 0x00, 0x00,
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    0x00, 0x00, 0x00, 0x00, 0x00, 0x00, 0x00, 0x00, 0x00};

static const uint8_t PROGMEM lightning_ico[350] = {
    0x00, 0x00, 0x00, 0x00, 0x00, 0x00, 0x00,
    0x00, 0x00, 0x00, 0x00, 0x00, 0x00, 0x00,
    0x00, 0x00, 0x00, 0x00, 0x00, 0x00, 0x00,
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    0x00, 0x00, 0x00, 0x00, 0x00, 0x00, 0x00};

static const uint8_t PROGMEM lightning[62] = {
    0x01, 0xe0,
    0x01, 0xe0,
    0x00, 0xe0,
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    0x00, 0x00};

static const uint8_t PROGMEM no_data_ico[350] = {
    0x00, 0x03, 0xff, 0xf0, 0x00, 0x00, 0x00,
    0x00, 0x3f, 0xff, 0xff, 0x00, 0x00, 0x00,
    0x01, 0xff, 0xff, 0xff, 0xe0, 0x00, 0x00,
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    0x00, 0x00, 0x00, 0x00, 0x07, 0xe0, 0x00};

static const uint8_t PROGMEM alarm_ico[350] = {
    0x00, 0x00, 0x00, 0x00, 0x00, 0x00, 0x00,
    0x00, 0x00, 0x00, 0x00, 0x00, 0x00, 0x00,
    0x00, 0x00, 0x00, 0x00, 0x00, 0x00, 0x00,
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    0x00, 0x00, 0x00, 0x00, 0x00, 0x00, 0x00};

static const uint8_t PROGMEM spotify_ico[100] = {
    0x00, 0x00, 0x00, 0x00,
    0x00, 0xff, 0x00, 0x00,
    0x03, 0xff, 0xc0, 0x00,
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    0x00, 0x00, 0x00, 0x00};

//  Functions

//  Functions - getDimentions

void getDimentions(String text)
{
  display.getTextBounds(text, 0, 0, &x5, &y5, &w, &h);
}

//  Functions - Eyes

void normal_eyes()
{
  display.clearDisplay();
  display.fillRect(12, 0, 45, 45, WHITE);
  display.fillRect(71, 0, 45, 45, WHITE);
  display.display();
}

void blink_eyes()
{
  display.clearDisplay();
  display.fillRect(12, 43, 45, 2, WHITE);
  display.fillRect(71, 43, 45, 2, WHITE);
  display.display();
}

void right_looking_eyes()
{
  display.clearDisplay();
  display.fillRect(12, 15, 30, 30, WHITE);
  display.fillRect(52, 0, 45, 45, WHITE);
  display.display();
}

void left_looking_eyes()
{
  display.clearDisplay();
  display.fillRect(31, 0, 45, 45, WHITE);
  display.fillRect(86, 15, 30, 30, WHITE);
  display.display();
}

void happy_eyes()
{
  display.clearDisplay();
  display.fillCircle(32, 22, 22, WHITE);
  display.fillCircle(94, 22, 22, WHITE);

  display.fillCircle(32, 27, 22, BLACK);
  display.fillCircle(94, 27, 22, BLACK);
  display.display();
}

void sleepy_eyes()
{
  display.clearDisplay();
  display.fillCircle(32, 27, 22, WHITE);
  display.fillCircle(94, 27, 22, WHITE);

  display.fillCircle(32, 22, 22, BLACK);
  display.fillCircle(94, 22, 22, BLACK);
  display.display();
}

//  Functions - Eyes - Alarm
void alarm_eyes()
{
  display.clearDisplay();
  display.fillRect(17, 17, 30, 30, WHITE);
  display.fillRect(81, 17, 30, 30, WHITE);

  display.display();
}

//  Functions - Eyes - Connection

void connected_eyes()
{
  display.clearDisplay();
  display.fillCircle(32, 45, 22, WHITE);
  display.fillCircle(94, 45, 22, WHITE);

  display.fillCircle(32, 50, 22, BLACK);
  display.fillCircle(94, 50, 22, BLACK);

  display.drawBitmap(108, 0, wifi_ico, 20, 20, WHITE);

  display.display();
}

void disconnected_eyes()
{
  display.clearDisplay();
  display.fillRect(12, 43, 45, 2, WHITE);
  display.fillRect(71, 43, 45, 2, WHITE);

  display.drawBitmap(108, 0, wifi_ico, 20, 20, WHITE);

  display.display();
}

//  Functions - Faces

void intro()
{
  display.clearDisplay();
  display.setFont(&FreeSans12pt7b);
  display.setCursor(0, 20);
  display.print("DeskBot");

  display.setFont();

  display.setCursor(0, 55);
  display.print("Initializing");

  display.fillRect(76, 28, 20, 20, WHITE);
  display.fillRect(100, 28, 20, 20, WHITE);

  display.display();

  cute.play(S_HAPPY);

  for (int i = 0; i < 5; i++)
  {
    display.print(".");
    display.display();
    delay(500);
  }
}

void clock_face()
{
  DateTime now = rtc.now();

  if (now.hour() < 10)
  {
    hour_str = "0" + String(now.hour(), DEC);
  }
  else
  {
    hour_str = String(now.hour(), DEC);
  }

  if (now.minute() < 10)
  {
    mins_str = "0" + String(now.minute(), DEC);
  }
  else
  {
    mins_str = String(now.minute(), DEC);
  }

  time_str = hour_str + ":" + mins_str;

  if (now.day() < 10)
  {
    date_str = "0" + String(now.day(), DEC);
  }
  else
  {
    date_str = String(now.day(), DEC);
  }

  dow_str = daysOfTheWeek[now.dayOfTheWeek()];

  date_and_dow_str = date_str + ", " + dow_str;

  display.setFont(&FreeSans18pt7b);

  getDimentions(time_str);

  display.clearDisplay();
  display.setCursor((128 - w) / 2, 38);
  display.print(time_str);

  display.setFont();

  getDimentions(date_and_dow_str);

  display.setCursor((128 - w) / 2, 45);
  display.print(date_and_dow_str);

  display.display();
}

void temperature()
{
  display.clearDisplay();
  display.setFont(&FreeSans18pt7b);
  get_data_from_api();

  if (WiFi.status() != WL_CONNECTED)
  {
    temp = "--";
  }

  display.drawBitmap(0, 12, temp_ico, 40, 40, WHITE);

  String temp_str = temp + " 'C";
  getDimentions(temp_str);

  display.setCursor(40, ((64 - h) / 2) + h);
  display.print(temp_str);

  display.display();
}

//  Functions - Faces - Weather

void rain1_face()
{
  display.clearDisplay();

  display.drawBitmap(11, 31, water1, 45, 13, WHITE);
  display.drawBitmap(70, 31, water1, 45, 13, WHITE);

  display.fillRect(12, 44, 44, 10, WHITE);
  display.fillRect(71, 44, 44, 10, WHITE);

  display.drawBitmap(12, 0, rain1, 44, 43, WHITE);
  display.drawBitmap(71, 0, rain1, 44, 43, WHITE);

  display.display();
}

void rain2_face()
{
  display.clearDisplay();

  display.drawBitmap(12, 31, water2, 45, 13, WHITE);
  display.drawBitmap(71, 31, water2, 45, 13, WHITE);

  display.fillRect(12, 44, 44, 10, WHITE);
  display.fillRect(71, 44, 44, 10, WHITE);

  display.drawBitmap(11, 0, rain2, 44, 43, WHITE);
  display.drawBitmap(70, 0, rain2, 44, 43, WHITE);

  display.display();
}

void weather_ico_face()
{
  display.clearDisplay();
  display.setFont(&FreeSans12pt7b);

  int y_to_change = 62;

  if (mood == "Rain" || mood == "Drizzle")
  {
    display.drawBitmap(39, 0, rain_ico, 50, 50, WHITE);
  }

  else if (mood == "Clouds")
  {
    display.drawBitmap(39, 0, cloud_ico, 50, 50, WHITE);
  }

  else if (mood == "Thunderstorm")
  {
    display.drawBitmap(39, 0, lightning_ico, 50, 50, WHITE);
    display.setFont();
    display.setTextSize(1);
    y_to_change = 50;
  }

  else
  {
    if (WiFi.status() != WL_CONNECTED)
    {
      mood = "No Data";
      display.drawBitmap(39, 0, no_data_ico, 50, 50, WHITE);
    }
    else
    {
      display.drawBitmap(39, 0, sun_ico, 50, 50, WHITE);
    }
  }

  getDimentions(mood);
  display.setCursor((128 - w) / 2, y_to_change);
  display.print(mood);

  display.display();
}

// Functions - API

void get_data_from_api()
{
  if ((millis() - api_last_time) >= api_timer_delay)
  {
    get_data();
    api_last_time = millis();
  }
}

void get_data()
{
  if (WiFi.status() == WL_CONNECTED)
  {
    String serverPath = "http://api.openweathermap.org/data/2.5/weather?q=" + city + "," + countryCode + "&APPID=" + openWeatherMapApiKey;

    jsonBuffer = httpGETRequest(serverPath.c_str());
    //    Serial.println(jsonBuffer);
    JSONVar myObject = JSON.parse(jsonBuffer);

    // JSON.typeof(jsonVar) can be used to get the type of the var
    if (JSON.typeof(myObject) == "undefined")
    {
      Serial.println("Parsing input failed!");
      return;
    }

    //    Serial.print("JSON object = ");
    //    Serial.println(myObject);

    temp = String(int(int(myObject["main"]["temp"]) - 273.15));
    //    Serial.print("Temperature: ");
    //    Serial.println(temp);

    mood = (const char *)myObject["weather"][0]["main"];
    //    Serial.print("Mood: ");
    //    Serial.println(mood);
  }
  else
  {
    Serial.println("WiFi Disconnected");
  }
}

//  Functions - Debugging

void debug_bot()
{
  intro();
  delay(2000);
  connected_eyes();
  delay(2000);
  disconnected_eyes();
  delay(2000);

  normal_eyes();
  delay(2000);
  blink_eyes();
  delay(2000);
  right_looking_eyes();
  delay(2000);
  left_looking_eyes();
  delay(2000);
  happy_eyes();
  delay(2000);
  sleepy_eyes();
  delay(2000);

  clock_face();
  delay(2000);
  temperature();
  delay(2000);
  weather_ico_face();
  delay(2000);

  for (int i = 0; i < 10; i++)
  {
    rain1_face();
    delay(250);
    rain2_face();
    delay(250);
  }

  //  thunder_face();
  delay(2000);

  Serial.println(digitalRead(TOUCH_SENSOR));
}

//  Functions - Main Functions

void touch_function()
{
  happy_eyes();
  cute.play(S_CUDDLY);
  delay(1500);

  DateTime now = rtc.now();

  if (!(now.hour() >= 22 || now.hour() <= 6))
  {
    clock_face();
    delay(5000);
  }

  get_data_from_api();

  temperature();
  delay(2000);

  weather_ico_face();
  delay(2000);

  if (mood == "Rain")
  {
    cute.play(S_SAD);

    for (int i = 0; i < 8; i++)
    {
      rain1_face();
      delay(250);
      rain2_face();
      delay(250);
    }
  }

  else if (mood == "Thunderstorm")
  {
    normal_eyes();
    cute.play(S_SLEEPING);
    delay(1500);

    display.clearDisplay();
    display.invertDisplay(true);
    display.display();

    digitalWrite(BUZZER_PIN, HIGH);
    delay(300);
    digitalWrite(BUZZER_PIN, LOW);

    display.invertDisplay(false);
    normal_eyes();
    delay(1500);
  }

  display.setFont();
  display.clearDisplay();
  connected_eyes();
  display.setCursor(0, 55);
  display.print(WiFi.localIP());
  display.display();

  cute.play(S_HAPPY_SHORT);

  delay(1000);
}

void random_function()
{
  if (lights == true)
  {
    if (mode_of_lights == 0)
    {
      s.write(1);
    }

    else if (mode_of_lights == 1)
    {
      s.write(2);
    }

    else if (mode_of_lights == 2)
    {
      s.write(4);
    }
  }

  else
  {
    s.write(0);
  }

  normal_eyes();

  if ((millis() - blink_last_time) >= blink_timer_delay)
  {
    blink_eyes();
    delay(500);

    blink_timer_delay = random(4000, 8000);
    blink_last_time = millis();
  }

  if ((millis() - side_last_time) >= side_timer_delay)
  {
    if (random(0, 2) == 0)
    {
      left_looking_eyes();
      delay(1000);
    }
    else
    {
      right_looking_eyes();
      delay(1000);
    }

    side_timer_delay = random(30000, 60000);
    side_last_time = millis();
  }
}

void check_for_alarms()
{
  DateTime now = rtc.now();

  //  Alarm 1
  while (now.hour() == alarm1[0] && now.minute() == alarm1[1] && alarm1_on == true)
  {

    alarm_function(alarm1_des);

    if (digitalRead(TOUCH_SENSOR) == 1)
    {
      cute.play(S_BUTTON_PUSHED);
      display.clearDisplay();
      display.drawBitmap(39, 0, alarm_ico, 50, 50, WHITE);

      display.setFont();
      display.invertDisplay(false);

      getDimentions("Turning off...");
      display.setCursor((128 - w) / 2, 55);
      display.print("Turning off...");

      display.display();
      delay((60 - now.second() + 10) * 1000);
      break;
    }

    DateTime now = rtc.now();

    if (now.minute() >= alarm1[1] + alarm1_duration)
    {
      break;
    }
  }

  //  Alarm 2
  while (now.hour() == alarm2[0] && now.minute() == alarm2[1] && alarm2_on == true)
  {

    alarm_function(alarm2_des);

    if (digitalRead(TOUCH_SENSOR) == 1)
    {
      cute.play(S_BUTTON_PUSHED);
      display.clearDisplay();
      display.drawBitmap(39, 0, alarm_ico, 50, 50, WHITE);

      display.setFont();
      display.invertDisplay(false);

      getDimentions("Turning off...");
      display.setCursor((128 - w) / 2, 55);
      display.print("Turning off...");

      display.display();
      delay((60 - now.second() + 10) * 1000);
      break;
    }

    DateTime now = rtc.now();

    if (now.minute() >= alarm2[1] + alarm2_duration)
    {
      break;
    }
  }

  //  Alarm 3
  while (now.hour() == alarm3[0] && now.minute() == alarm3[1] && alarm3_on == true)
  {

    alarm_function(alarm3_des);

    if (digitalRead(TOUCH_SENSOR) == 1)
    {
      display.clearDisplay();
      display.setFont();
      cute.play(S_BUTTON_PUSHED);
      display.clearDisplay();
      display.drawBitmap(39, 0, alarm_ico, 50, 50, WHITE);

      display.setFont();
      display.invertDisplay(false);

      getDimentions("Turning off...");
      display.setCursor((128 - w) / 2, 55);
      display.print("Turning off...");

      display.display();
      delay((60 - now.second() + 10) * 1000);
      break;
    }

    DateTime now = rtc.now();

    if (now.minute() >= alarm3[1] + alarm3_duration)
    {
      break;
    }
  }

  //  Alarm 4
  while (now.hour() == alarm4[0] && now.minute() == alarm4[1] && alarm4_on == true)
  {

    alarm_function(alarm4_des);

    if (digitalRead(TOUCH_SENSOR) == 1)
    {
      cute.play(S_BUTTON_PUSHED);
      display.clearDisplay();
      display.drawBitmap(39, 0, alarm_ico, 50, 50, WHITE);

      display.setFont();
      display.invertDisplay(false);

      getDimentions("Turning off...");
      display.setCursor((128 - w) / 2, 55);
      display.print("Turning off...");

      display.display();
      delay((60 - now.second() + 10) * 1000);
      break;
    }

    DateTime now = rtc.now();

    if (now.minute() >= alarm4[1] + alarm4_duration)
    {
      break;
    }
  }

  //  Alarm 5
  while (now.hour() == alarm5[0] && now.minute() == alarm5[1] && alarm5_on == true)
  {

    alarm_function(alarm5_des);

    if (digitalRead(TOUCH_SENSOR) == 1)
    {
      cute.play(S_BUTTON_PUSHED);
      display.clearDisplay();
      display.drawBitmap(39, 0, alarm_ico, 50, 50, WHITE);

      display.setFont();
      display.invertDisplay(false);

      getDimentions("Turning off...");
      display.setCursor((128 - w) / 2, 55);
      display.print("Turning off...");

      display.display();
      delay((60 - now.second() + 10) * 1000);
      break;
    }

    DateTime now = rtc.now();

    if (now.minute() >= alarm5[1] + alarm5_duration)
    {
      break;
    }
  }
}

void basic_function()
{
  if (digitalRead(TOUCH_SENSOR) == 1)
  {
    touch_function();
  }

  else
  {
    if (is_night == true && is_night_func_goon == true)
    {
      s.write(8);
      clock_face();

      if ((millis() - sleep_last_time) >= sleep_timer_delay)
      {
        sleepy_eyes();
        delay(2000);

        sleep_timer_delay = random(300000, 600000);
        sleep_last_time = millis();
      }
    }

    else
    {
      random_function();
    }
  }
}

void alarm_function(String alarm_des)
{
  s.write(7);

  display.clearDisplay();
  display.drawBitmap(39, 0, alarm_ico, 50, 50, WHITE);

  display.setFont();

  getDimentions(alarm_des.substring(0, 21));
  display.setCursor((128 - w) / 2, 55);
  display.print(alarm_des.substring(0, 21));

  display.display();

  display.invertDisplay(true);
  cute.play(S_OHOOH2);
  display.invertDisplay(false);
  cute.play(S_OHOOH2);
}

// Fuctions - Spotify

void printCurrentlyPlayingToSerial(CurrentlyPlaying currentlyPlaying)
{
  display.clearDisplay();

  if (currentlyPlaying.isPlaying)
  {
    display.invertDisplay(false);
    playing = true;
  }
  else
  {
    display.invertDisplay(true);
    playing = false;
  }

  track = (const char *)currentlyPlaying.trackName;
  track_x_max = -6 * track.length();

  artists = "";

  for (int i = 0; i < currentlyPlaying.numArtists; i++)
  {
    artists += (const char *)currentlyPlaying.artists[i].artistName;

    if (i != currentlyPlaying.numArtists - 1)
    {
      artists += ", ";
    }
  }

  artist_x_max = -6 * artists.length();

  progress_of_track = currentlyPlaying.progressMs; // duration passed in the song
  duration_of_track = currentlyPlaying.durationMs; // Length of Song

  display.display();
}

void setup()
{
  //  Serial
  Serial.begin(115200);
  s.begin(9600);
  s.write(0);

  Serial.println("  ________            ______ ________      _____");
  Serial.println("  ___  __ \______________  /____  __ )_______  /_");
  Serial.println("  __  / / /  _ \_  ___/_  //_/_  __  |  __ \  __/");
  Serial.println("  _  /_/ //  __/(__  )_  ,<  _  /_/ // /_/ / /_");
  Serial.println("  /_____/ \___//____/ /_/|_| /_____/ \____/\__/    by Hiruka Chansilu");

  //  GPIO
  pinMode(GREEN_LED, OUTPUT);
  pinMode(RED_LED, OUTPUT);
  pinMode(TOUCH_SENSOR, INPUT);

  randomSeed(analogRead(0));

  cute.init(BUZZER_PIN);

  //  Oled
  if (!display.begin(SSD1306_SWITCHCAPVCC, SCREEN_ADDRESS))
  {
    Serial.println(F("SSD1306 allocation failed"));
    for (;;)
      ; // Don't proceed, loop forever
  }

  display.display();
  delay(2000);
  display.clearDisplay();
  display.setTextColor(WHITE);
  display.setTextSize(1);
  display.setTextWrap(false);

  intro();

  WiFi.mode(WIFI_STA);
  WiFi.begin(ssid, password);
  Serial.println("Connecting");

  sleepy_eyes();
  display.setCursor(0, 55);
  display.print("Connecting...");
  display.display();

  while (WiFi.status() != WL_CONNECTED)
  {
    if (tried_times > 25)
    {
      s.write(6);
      digitalWrite(RED_LED, HIGH);
      digitalWrite(GREEN_LED, LOW);

      disconnected_eyes();
      display.setCursor(0, 55);
      display.print("No Wifi...");
      display.display();

      cute.play(S_CONFUSED);
      delay(2000);
      break;
    }
    delay(500);

    Serial.print(".");
    display.print(".");
    display.display();

    tried_times++;
  }

  Serial.println("");

  if (WiFi.status() == WL_CONNECTED)
  {
    s.write(5);
    Serial.println("");
    Serial.print("Connected to WiFi network with IP Address: ");
    Serial.println(WiFi.localIP());

    digitalWrite(GREEN_LED, HIGH);
    digitalWrite(RED_LED, LOW);

    connected_eyes();
    display.setCursor(0, 55);
    display.print("Connected to Wifi...");
    display.display();

    cute.play(S_CONNECTION);

    delay(2000);

    display.clearDisplay();
    connected_eyes();
    display.setCursor(0, 55);
    display.print(WiFi.localIP());
    display.display();

    delay(2000);
  }

  client.setFingerprint(SPOTIFY_FINGERPRINT); // These expire every few months

  Serial.println("Refreshing Access Tokens");
  if (!spotify.refreshAccessToken())
  {
    Serial.println("Failed to get access tokens");
  }

#ifndef ESP8266
  while (!Serial)
    ; // wait for serial port to connect. Needed for native USB
#endif

  if (!rtc.begin())
  {
    display.clearDisplay();
    display.setCursor(0, 55);
    display.print("Couldn't find RTC...");
    display.display();

    Serial.println("Couldn't find RTC");

    cute.play(S_CONFUSED);
  }

  server.on("/", handle_OnConnect);
  server.on("/lightson", handle_lightson);
  server.on("/lightsoff", handle_lightsoff);
  server.on("/normalon", handle_normalon);
  server.on("/gamingon", handle_gamingon);
  server.on("/studyon", handle_studyon);
  server.on("/touch", handle_touch);
  server.on("/reset", handle_reset);
  server.onNotFound(handle_NotFound);

  server.begin();
  Serial.println("HTTP server started");

  //  rtc.adjust(DateTime(2022, 1, 12, 23, 1, 0));

  display.setFont(&FreeSans18pt7b);
  get_data();
}

// Web Server Functions

void handle_OnConnect()
{
  lights = true;
  mode_of_lights = 0;

  server.send(200, "text/html", SendHTML(lights, mode_of_lights));
}

void handle_lightson()
{
  lights = true;
  mode_of_lights = 0;

  server.send(200, "text/html", SendHTML(lights, mode_of_lights));
}

void handle_lightsoff()
{
  lights = false;
  mode_of_lights = 10;
  s.write(0);
  s.write(9);

  server.send(200, "text/html", SendHTML(lights, mode_of_lights));
}

void handle_normalon()
{
  mode_of_lights = 0;

  server.send(200, "text/html", SendHTML(lights, mode_of_lights));
}

void handle_gamingon()
{
  mode_of_lights = 1;

  server.send(200, "text/html", SendHTML(lights, mode_of_lights));
}

void handle_studyon()
{
  mode_of_lights = 2;

  server.send(200, "text/html", SendHTML(lights, mode_of_lights));
}

void handle_touch()
{
  touch_function();
  lights = lights;
  mode_of_lights = mode_of_lights;

  server.send(200, "text/html", SendHTML(lights, mode_of_lights));
}

void handle_reset()
{
  ESP.restart();

  lights = false;
  mode_of_lights = 10;

  server.send(200, "text/html", SendHTML(lights, mode_of_lights));
}

void handle_NotFound()
{
  server.send(404, "text/plain", "Not found");
}

String SendHTML(bool lights_local, int mode_of_lights_local)
{
  String code = "<!DOCTYPE html><html lang=\"en\"><head><meta charset=\"UTF-8\"><meta http-equiv=\"X-UA-Compatible\" content=\"IE=edge\"><meta name=\"viewport\" content=\"width=device-width, initial-scale=1.0\"><title>Deskbot</title>";
  code += "<style>body {background-color: #e2e2e2;background-image: linear-gradient(90deg, #c9d6ff 0%, #e2e2e2 150%);font-family: \"Montserrat\", sans-serif;font-weight: 400;margin: 0;}";
  code += "a {text-decoration: none;color: rgb(88, 88, 88);}h1 {margin: 5%;font-weight: 600;}";
  code += ".deskbot-image {width: 80%;position: absolute;bottom: 0;right: 0;filter: contrast(70%);z-index: -1;}";
  code += ".card {display: flex;flex-direction: column;align-items: center;justify-content: center;height: 150px;width: 150px;background-color: #fff;border-radius: 20px;margin: 10px;text-align: center;}";
  code += ".card img {width: 96px;}.card h3 {margin: 5px 0 0;}.card:hover {transform: scale(103%);box-shadow: 0 0 30px rgb(196, 196, 196);color: #000;}.container {margin: auto;max-width: 840px;display: flex;flex-wrap: wrap;align-items: center;justify-content: center;}";
  code += ".foot {color: #686868;position: absolute;bottom: 0;width: 100%;text-align: center;}@media screen and (min-width: 850px) {body {text-align: center;}.deskbot-image {width: auto;height: 40%;}}</style>";
  code += "<link rel=\"icon\" type=\"image/icon\" href=\"https://i.ibb.co/1mbjkfX/Favicon-Asset-13.png\"><link rel=\"preconnect\" href=\"https://fonts.googleapis.com\"><link rel=\"preconnect\" href=\"https://fonts.gstatic.com\" crossorigin><link href=\"https://fonts.googleapis.com/css2?family=Montserrat:wght@300;400;500&display=swap\" rel=\"stylesheet\"></head>";

  code += "<body><img class=\"deskbot-image\" src=\"https://i.ibb.co/wNsKjvq/Deskbot-image-Asset-14.png\" alt=\"deskbot-image\">";
  code += "<h1>DeskBot ©</h1><div class=\"container\">";

  if (lights_local == true)
  {
    code += "<a href=\"/lightsoff\"><div class=\"card\" ";
    code += "style=\"background-color: #c2c2c2;\"";
  }

  else
  {
    code += "<a href=\"/lightson\"><div class=\"card\" ";
  }

  code += "><img src=\"https://img.icons8.com/fluency/96/000000/led-diode.png\" /><h3>Lights</h3></div></a>";

  code += "<a href=\"/normalon\"><div class=\"card\" ";

  if (mode_of_lights_local == 0)
  {
    code += "style=\"background-color: #c2c2c2;\" ";
  }
  code += "><img src=\"https://img.icons8.com/fluency/96/000000/rgb-circle-2.png\" /><h3>Normal Mode</h3></div></a>";

  code += "<a href=\"/gamingon\"><div class=\"card\" ";

  if (mode_of_lights_local == 1)
  {
    code += "style=\"background-color: #c2c2c2;\"";
  }

  code += "><img src=\"https://img.icons8.com/fluency/96/000000/pixel-heart.png\" /><h3>Gaming Mode</h3></div></a>";

  code += "<a href=\"/studyon\"><div class=\"card\" ";

  if (mode_of_lights_local == 2)
  {
    code += "style=\"background-color: #c2c2c2;\"";
  }

  code += "><img src=\"https://img.icons8.com/fluency/96/000000/saving-book.png\" /><h3>Study Mode</h3></div></a>";

  code += "<a href=\"/touch\"><div class=\"card\"><img src=\"https://img.icons8.com/fluency/96/000000/3d-touch.png\" /><h3>Send Touch</h3></div></a>";

  code += "<a href=\"/reset\"><div class=\"card\"><img src=\"https://img.icons8.com/fluency/96/000000/recurring-appointment.png\" /><h3>Reset</h3></div></a></div>";

  code += "<p class=\"foot\">A Project by <a href=\"https://hirukachansilu.tk\">Hiruka Chansilu</a>©</p></body></html>";

  return code;
}

void loop()
{
  //  debug_bot();

  DateTime now = rtc.now();

  if (now.hour() >= 22 || now.hour() <= 6)
  {
    is_night = true;
  }

  else
  {
    is_night = false;
  }

  if (WiFi.status() == WL_CONNECTED)
  {
    digitalWrite(GREEN_LED, HIGH);
    digitalWrite(RED_LED, LOW);
  }
  else
  {
    digitalWrite(GREEN_LED, LOW);
    digitalWrite(RED_LED, HIGH);
  }

  if ((millis() - rand_on_last_time) >= rand_on_timer_delay && is_night_func_goon == true)
  {
    is_night_func_goon = false;
    rand_on_timer_delay = random(600000, 1200000);
    rand_on_last_time = millis();
    rand_off_last_time = millis();
  }

  if ((millis() - rand_off_last_time) >= rand_off_timer_delay && is_night_func_goon == false)
  {
    is_night_func_goon = true;
    rand_off_timer_delay = random(180000, 600000);
  }

  check_for_alarms();

  if (millis() - spotify_last_time >= spotify_timer_delay)
  {
    status = spotify.getCurrentlyPlaying(printCurrentlyPlayingToSerial, SPOTIFY_MARKET);
    spotify_last_time = millis();
  }

  if (status == 200)
  {
    s.write(3);
    display.clearDisplay();
    display.setTextSize(1);
    display.setFont();
    spotify_timer_delay = 2000;

    display.drawBitmap(0, 0, spotify_ico, 25, 25, WHITE);
    display.setCursor(28, 10);
    display.print("Now Playing...");

    display.setCursor(track_x, 28);
    display.println(track);

    display.setCursor(artist_x, 38);
    display.println(artists);

    display.fillRect(0, 62, map(progress_of_track, 0, duration_of_track, 0, 128), 2, WHITE);
    display.display();

    if (track.length() > 21)
    {
      if (track_x == 0)
      {
        delay(500);
      }

      track_x = track_x - 1;
      if (track_x < track_x_max)
      {
        track_x = 0;
      }
    }

    if (artists.length() > 21)
    {
      if (artist_x == 0)
      {
        delay(500);
      }
      artist_x = artist_x - 1;
      if (artist_x < artist_x_max)
      {
        artist_x = 0;
      }
    }

    if (pre_track != track)
    {
      track_x = 0;
      artist_x = 0;
      pre_track = track;
    }
  }

  else
  {
    server.handleClient();
    basic_function();
    spotify_timer_delay = 60000;
    display.invertDisplay(false);
  }

  if (digitalRead(TOUCH_SENSOR) == 1 && status == 200)
  {
    if (playing == true)
    {
      display.invertDisplay(true);
      display.display();
      playing = false;
      spotify.pause();
      delay(2000);
    }
    else
    {
      display.invertDisplay(false);
      display.display();
      playing = true;
      spotify.play();
      delay(2000);
    }
  }
}
